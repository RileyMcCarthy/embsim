## p2-qemu/qemu-target/hw-p2/Kconfig
```kconfig
# SPDX-License-Identifier: LGPL-2.1-or-later
# Copyright (c) 2026 Riley McCarthy

config P2_BOARD
    bool
    default y
    depends on P2
```

## p2-qemu/qemu-target/target-p2/Kconfig
```kconfig
# SPDX-License-Identifier: LGPL-2.1-or-later
# Copyright (c) 2026 Riley McCarthy

config P2
    bool
```
